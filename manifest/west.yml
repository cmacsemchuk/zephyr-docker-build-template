## manifest/west.yml
```yaml
manifest:
  version: "0.13"
  self:
    path: app
  projects:
    - name: zephyr
      url: https://github.com/zephyrproject-rtos/zephyr
      revision: bcc4689cd01620c1a5408986085343e656ec5a71
      import: true
```
